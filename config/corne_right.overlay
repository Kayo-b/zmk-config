/*
 * Copyright (c) 2024
 * SPDX-License-Identifier: MIT
 */

&i2c0 {
    status = "okay";

    oled: ssd1306@3c {
        compatible = "solomon,ssd1306fb";
        reg = <0x3c>;
        width = <128>;
        height = <32>;
        segment-offset = <0>;
        page-offset = <0>;
        display-offset = <0>;
        multiplex-ratio = <31>;
        segment-remap;
        com-invdir;
        prechargep = <0x22>;
        inversion-on;
    };
};

/ {
    chosen {
        zephyr,display = &oled;
    };
};